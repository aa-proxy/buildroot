## external/boot/uboot/Config.in
```kconfig
config BR2_TARGET_UBOOT_ROCKCHIP
    bool "Enable extra U-Boot build steps for Rockchip"
    depends on BR2_TARGET_UBOOT

config BR2_TARGET_UBOOT_ROCKCHIP_IDBLOCK
    bool "Pack a raw Rockchip idblock.bin"
    depends on BR2_TARGET_UBOOT_ROCKCHIP
    help
      Run "make.sh --idblock", producing idblock.bin: the raw ID block
      the BootROM reads from sector 0x40 of eMMC or SD.

      Leave this off for boards flashed into SPI NAND with the Rockchip
      tools. Those need "make.sh --spl" instead, which packs the
      download.bin and idblock.img pair those tools expect.

config BR2_TARGET_UBOOT_ROCKCHIP_IDBLOADER
    bool "Build a raw Rockchip idbloader.img"
    depends on BR2_TARGET_UBOOT_ROCKCHIP
    help
      Wrap the rkbin DDR init blob with "mkimage -T rksd" and append the
      miniloader, producing idbloader.img: the ID block the BootROM reads
      from sector 0x40 of eMMC or SD.

      This is the same thing "make.sh --idblock" packs, for the older
      Rockchip U-Boot trees whose make.sh has no such sub-command.

config BR2_TARGET_UBOOT_ROCKCHIP_IDBLOADER_SOC
    string "SoC name passed to mkimage -n"
    depends on BR2_TARGET_UBOOT_ROCKCHIP_IDBLOADER
    help
      One of the names in the U-Boot tree's tools/rkcommon.c, e.g. "rk3308".

config BR2_TARGET_UBOOT_ROCKCHIP_IDBLOADER_RKBIN_REPO
    string "GitHub owner/repo to take the idbloader blobs from"
    depends on BR2_TARGET_UBOOT_ROCKCHIP_IDBLOADER
    help
      Leave empty to use the rkbin the package already downloads. Set it
      when a board needs blobs from a different rkbin than the one that
      supplies tools/mkimage and the trust images, e.g. "radxa/rkbin" for
      the rk3308 builds that upstream has since dropped. Needs
      BR2_TARGET_UBOOT_ROCKCHIP_IDBLOADER_RKBIN_VERSION set as well.

config BR2_TARGET_UBOOT_ROCKCHIP_IDBLOADER_RKBIN_VERSION
    string "git revision of the above"
    depends on BR2_TARGET_UBOOT_ROCKCHIP_IDBLOADER

config BR2_TARGET_UBOOT_ROCKCHIP_IDBLOADER_DDR_BIN
    string "DDR init blob"
    depends on BR2_TARGET_UBOOT_ROCKCHIP_IDBLOADER
    help
      Relative to whichever rkbin the blobs come from, or an absolute path
      for a board that has to ship its own.

config BR2_TARGET_UBOOT_ROCKCHIP_IDBLOADER_MINILOADER_BIN
    string "miniloader blob"
    depends on BR2_TARGET_UBOOT_ROCKCHIP_IDBLOADER
    help
      Relative to whichever rkbin the blobs come from, or an absolute path.

config BR2_TARGET_UBOOT_ROCKCHIP_ENV
    bool "Enable Rockchip U-Boot env"
    depends on BR2_TARGET_UBOOT_ROCKCHIP

config BR2_TARGET_UBOOT_ROCKCHIP_ENV_FILE
    string "Rockchip U-Boot env file"
    depends on BR2_TARGET_UBOOT_ROCKCHIP && BR2_TARGET_UBOOT_ROCKCHIP_ENV

config BR2_TARGET_UBOOT_ROCKCHIP_BOOT_SCRIPT
    bool "Enable Rockchip U-Boot boot script"
    depends on BR2_TARGET_UBOOT_ROCKCHIP

config BR2_TARGET_UBOOT_ROCKCHIP_BOOT_SCRIPT_FILE
    string "Rockchip U-Boot boot script file"
    depends on BR2_TARGET_UBOOT_ROCKCHIP && BR2_TARGET_UBOOT_ROCKCHIP_BOOT_SCRIPT
```

## external/configs/aaw1-cs317_defconfig
```kconfig
BR2_LINUX_KERNEL_CUSTOM_REPO_VERSION="f7f66056cb072d1bcfd10292b5c08194a1f2a654"
BR2_LINUX_KERNEL_USE_DEFCONFIG=n
BR2_LINUX_KERNEL_USE_CUSTOM_CONFIG=y
BR2_LINUX_KERNEL_CUSTOM_CONFIG_FILE="$(BR2_EXTERNAL_AA_PROXY_OS_PATH)/board/aaw1-cs317/kernel.config"
BR2_LINUX_KERNEL_INTREE_DTS_NAME="rv1109-cs317"
BR2_LINUX_KERNEL_IMAGE_TARGET_NAME="zImage"
BR2_LINUX_KERNEL_INSTALL_TARGET=y
BR2_GLOBAL_PATCH_DIR="$(BR2_EXTERNAL_AA_PROXY_OS_PATH)/board/aaw1-cs317/patches"
BR2_TARGET_UBOOT_CUSTOM_REPO_VERSION="c87f1c8fce355af1da124ff9b3e5a4c2123e44d0"
BR2_TARGET_UBOOT_BOARD_DEFCONFIG="rv1126"
BR2_TARGET_UBOOT_ROCKCHIP_BOOT_SCRIPT=y
BR2_TARGET_UBOOT_ROCKCHIP_IDBLOCK=y
BR2_TARGET_UBOOT_ROCKCHIP_BOOT_SCRIPT_FILE="$(BR2_EXTERNAL_AA_PROXY_OS_PATH)/board/aaw1-cs317/boot.cmd"
BR2_ROOTFS_OVERLAY="$(BR2_EXTERNAL_AA_PROXY_OS_PATH)/rootfs_overlay $(BR2_EXTERNAL_AA_PROXY_OS_PATH)/board/aaw-common/rootfs_overlay $(BR2_EXTERNAL_AA_PROXY_OS_PATH)/board/aaw1-cs317/rootfs_overlay"
BR2_ROOTFS_POST_IMAGE_SCRIPT="$(BR2_EXTERNAL_AA_PROXY_OS_PATH)/board/aaw1-cs317/post-image.sh"
BR2_TARGET_GENERIC_GETTY_PORT="ttyS2"
BR2_TARGET_ROOTFS_EXT2=y
BR2_TARGET_ROOTFS_EXT2_4=y
BR2_TARGET_ROOTFS_EXT2_SIZE="200M"

# Packages
BR2_PACKAGE_RKWIFIBT_AP625X=y
BR2_PACKAGE_RKWIFIBT_BT_UART_DEV="ttyS0"
BR2_PACKAGE_RKWIFIBT_BT_UART_BAUDRATE="1500000"
BR2_PACKAGE_AA_PROXY_RS_IO_URING=n
```

## external/configs/aaw2b_defconfig
```kconfig
BR2_LINUX_KERNEL_DEFCONFIG="aaw2b"
BR2_LINUX_KERNEL_INTREE_DTS_NAME="aaw2b"
BR2_LINUX_KERNEL_IMAGE_TARGET_NAME="aaw2b.img"
BR2_LINUX_KERNEL_IMAGE_TARGET_CUSTOM=y
BR2_LINUX_KERNEL_IMAGE_NAME="../../../boot.img" # This is a bit of a hack
BR2_TARGET_UBOOT_BOARD_DEFCONFIG="aaw2b"
BR2_TARGET_UBOOT_ROCKCHIP_ENV=y
BR2_TARGET_UBOOT_ROCKCHIP_ENV_FILE="$(BR2_EXTERNAL_AA_PROXY_OS_PATH)/board/aaw2b/env.txt"
BR2_GLOBAL_PATCH_DIR="$(BR2_EXTERNAL_AA_PROXY_OS_PATH)/board/aaw2b/patches"
BR2_ROOTFS_OVERLAY="$(BR2_EXTERNAL_AA_PROXY_OS_PATH)/rootfs_overlay $(BR2_EXTERNAL_AA_PROXY_OS_PATH)/board/aaw-common/rootfs_overlay $(BR2_EXTERNAL_AA_PROXY_OS_PATH)/board/aaw2b/rootfs_overlay"
BR2_ROOTFS_POST_IMAGE_SCRIPT="$(BR2_EXTERNAL_AA_PROXY_OS_PATH)/board/aaw2b/post-image.sh"
BR2_TARGET_GENERIC_GETTY_PORT="ttyS2"
BR2_PACKAGE_HOST_MTD=y
BR2_TARGET_ROOTFS_SQUASHFS=y
BR2_TARGET_ROOTFS_SQUASHFS4_ZSTD=y

# Packages
BR2_PACKAGE_RKWIFIBT_RTL8733BS=y
BR2_PACKAGE_RKWIFIBT_BT_UART_DEV="ttyS5"
BR2_PACKAGE_RKWIFIBT_BT_UART_BAUDRATE="115200"
```

## external/configs/aaw3_defconfig
```kconfig
BR2_LINUX_KERNEL_DEFCONFIG="aaw3"
BR2_LINUX_KERNEL_INTREE_DTS_NAME="aaw3"
BR2_LINUX_KERNEL_IMAGE_TARGET_NAME="aaw3.img"
BR2_LINUX_KERNEL_IMAGE_TARGET_CUSTOM=y
BR2_LINUX_KERNEL_IMAGE_NAME="../../../boot.img" # This is a bit of a hack
BR2_TARGET_UBOOT_BOARD_DEFCONFIG="aaw3"
BR2_TARGET_UBOOT_ROCKCHIP_ENV=y
BR2_TARGET_UBOOT_ROCKCHIP_ENV_FILE="$(BR2_EXTERNAL_AA_PROXY_OS_PATH)/board/aaw3/env.txt"
BR2_ROOTFS_OVERLAY="$(BR2_EXTERNAL_AA_PROXY_OS_PATH)/rootfs_overlay $(BR2_EXTERNAL_AA_PROXY_OS_PATH)/board/aaw-common/rootfs_overlay $(BR2_EXTERNAL_AA_PROXY_OS_PATH)/board/aaw3/rootfs_overlay"
BR2_ROOTFS_POST_IMAGE_SCRIPT="$(BR2_EXTERNAL_AA_PROXY_OS_PATH)/board/aaw3/post-image.sh"
BR2_TARGET_GENERIC_GETTY_PORT="ttyS0"
BR2_PACKAGE_HOST_MTD=y
BR2_TARGET_ROOTFS_SQUASHFS=y
BR2_TARGET_ROOTFS_SQUASHFS4_ZSTD=y

# Packages
BR2_PACKAGE_RKWIFIBT_AIC8800=y
BR2_PACKAGE_RKWIFIBT_BT_UART_DEV="ttyS2"
BR2_PACKAGE_RKWIFIBT_BT_UART_BAUDRATE="1500000"
```

## external/configs/orangepi-z2w_defconfig
```kconfig
# Architecture
BR2_aarch64=y
BR2_ARM_FPU_VFPV4=y

# Toolchain
BR2_TOOLCHAIN_EXTERNAL=y
BR2_TOOLCHAIN_EXTERNAL_BOOTLIN=y
BR2_TOOLCHAIN_EXTERNAL_BOOTLIN_AARCH64_GLIBC_STABLE=y

# Global
BR2_GLOBAL_PATCH_DIR="$(BR2_EXTERNAL_AA_PROXY_OS_PATH)/patches $(BR2_EXTERNAL_AA_PROXY_OS_PATH)/board/orangepi-z2w/patches"

# TF-A
BR2_TARGET_ARM_TRUSTED_FIRMWARE=y
BR2_TARGET_ARM_TRUSTED_FIRMWARE_PLATFORM="sun50i_h616"

# U-Boot
BR2_TARGET_UBOOT=y
BR2_TARGET_UBOOT_BOARD_DEFCONFIG="orangepi_zero2w"
BR2_TARGET_UBOOT_CONFIG_FRAGMENT_FILES="$(BR2_EXTERNAL_AA_PROXY_OS_PATH)/board/common/uboot/fragments/bootdelay.fragment"
BR2_TARGET_UBOOT_NEEDS_DTC=y
BR2_TARGET_UBOOT_NEEDS_PYLIBFDT=y
BR2_TARGET_UBOOT_NEEDS_OPENSSL=y
BR2_TARGET_UBOOT_NEEDS_GNUTLS=y
BR2_TARGET_UBOOT_NEEDS_ATF_BL31=y
BR2_TARGET_UBOOT_SPL=y
BR2_TARGET_UBOOT_SPL_NAME="u-boot-sunxi-with-spl.bin"
BR2_TARGET_UBOOT_CUSTOM_MAKEOPTS="SCP=/dev/null"
BR2_PACKAGE_HOST_UBOOT_TOOLS=y
BR2_PACKAGE_HOST_UBOOT_TOOLS_BOOT_SCRIPT=y
BR2_PACKAGE_HOST_UBOOT_TOOLS_BOOT_SCRIPT_SOURCE="$(BR2_EXTERNAL_AA_PROXY_OS_PATH)/board/orangepi-z2w/boot.cmd"

# Kernel
BR2_LINUX_KERNEL=y
BR2_LINUX_KERNEL_USE_CUSTOM_CONFIG=y
BR2_LINUX_KERNEL_CUSTOM_CONFIG_FILE="$(BR2_EXTERNAL_AA_PROXY_OS_PATH)/board/orangepi-z2w/linux/kernel.config"
BR2_LINUX_KERNEL_DTS_SUPPORT=y
BR2_LINUX_KERNEL_INTREE_DTS_NAME="allwinner/sun50i-h618-orangepi-zero2w"
BR2_LINUX_KERNEL_CUSTOM_DTS_DIR="$(BR2_EXTERNAL_AA_PROXY_OS_PATH)/board/orangepi-z2w/linux/dts"
BR2_LINUX_KERNEL_INSTALL_TARGET=y
BR2_LINUX_KERNEL_NEEDS_HOST_OPENSSL=y

# Wireless Drivers
BR2_PACKAGE_UWE5622=y
BR2_PACKAGE_UWE5622_WIFI_PS=y
BR2_PACKAGE_UWE5622_BLUETOOTH=y

# Hostapd
BR2_PACKAGE_HOSTAPD=y

# SWUpdate
BR2_PACKAGE_SWUPDATE=y
BR2_PACKAGE_LIBCONFIG=y
BR2_PACKAGE_ZLIB=y
BR2_PACKAGE_OPENSSL=y
BR2_PACKAGE_SWUPDATE_WEBSERVER=y
BR2_PACKAGE_SWUPDATE_CONFIG="$(BR2_EXTERNAL_AA_PROXY_OS_PATH)/board/orangepi-z2w/swupdate/swupdate.config"

# Rootfs overlay
BR2_ROOTFS_OVERLAY="$(BR2_EXTERNAL_AA_PROXY_OS_PATH)/rootfs_overlay $(BR2_EXTERNAL_AA_PROXY_OS_PATH)/board/orangepi-z2w/rootfs_overlay"

# Rootfs
BR2_TARGET_GENERIC_REMOUNT_ROOTFS_RW=n
BR2_TARGET_ROOTFS_EXT2=y
BR2_TARGET_ROOTFS_EXT2_4=y
BR2_TARGET_ROOTFS_EXT2_SIZE="128M"

# Required tools to create the SD image and update
BR2_PACKAGE_HOST_DOSFSTOOLS=y
BR2_PACKAGE_HOST_GENIMAGE=y
BR2_PACKAGE_HOST_MTOOLS=y
BR2_PACKAGE_HOST_SWUGENERATOR=y

# Post image/build scripts
BR2_ROOTFS_POST_BUILD_SCRIPT="$(BR2_EXTERNAL_AA_PROXY_OS_PATH)/board/common/post-build.sh"
BR2_ROOTFS_POST_IMAGE_SCRIPT="$(BR2_EXTERNAL_AA_PROXY_OS_PATH)/board/orangepi-z2w/post-image.sh"
```

## external/configs/rpi3a_defconfig
```kconfig
BR2_aarch64=y
BR2_cortex_a53=y
BR2_ARM_FPU_VFPV4=y
BR2_LINUX_KERNEL_DEFCONFIG="bcm2711"
BR2_LINUX_KERNEL_INTREE_DTS_NAME="broadcom/bcm2710-rpi-3-b broadcom/bcm2710-rpi-3-b-plus broadcom/bcm2710-rpi-cm3"
BR2_PACKAGE_RPI_FIRMWARE_BOOTCODE_BIN=y
BR2_PACKAGE_RPI_FIRMWARE_VARIANT_PI=y
BR2_TARGET_UBOOT_BOARD_DEFCONFIG="rpi_arm64"

# Hardware H.264 codec (bcm2835-codec) for the video overlay
BR2_LINUX_KERNEL_CONFIG_FRAGMENT_FILES="$(BR2_EXTERNAL_AA_PROXY_OS_PATH)/board/common/kernel.config $(BR2_EXTERNAL_AA_PROXY_OS_PATH)/board/rpi/kernel.config"
```

## external/configs/rpi4_defconfig
```kconfig
BR2_aarch64=y
BR2_cortex_a72=y
BR2_ARM_FPU_VFPV4=y
BR2_LINUX_KERNEL_DEFCONFIG="bcm2711"
BR2_LINUX_KERNEL_INTREE_DTS_NAME="broadcom/bcm2711-rpi-4-b"
BR2_PACKAGE_RPI_FIRMWARE_VARIANT_PI4=y
BR2_SYSTEM_DHCP="eth0"
BR2_TARGET_UBOOT_BOARD_DEFCONFIG="rpi_4"

# Hardware H.264 codec (bcm2835-codec) for the video overlay
BR2_LINUX_KERNEL_CONFIG_FRAGMENT_FILES="$(BR2_EXTERNAL_AA_PROXY_OS_PATH)/board/common/kernel.config $(BR2_EXTERNAL_AA_PROXY_OS_PATH)/board/rpi/kernel.config"
```

## external/package/aa-proxy-obd/Config.in
```kconfig
config BR2_PACKAGE_AA_PROXY_OBD
	bool "aa-proxy-obd"
	depends on BR2_PACKAGE_HOST_RUSTC_TARGET_ARCH_SUPPORTS
	select BR2_PACKAGE_HOST_RUSTC
	help
	  Rust daemon to read EV OBD-II parameters via bluetooth dongle.
	  Started automatically by aa-proxy-rs via ev_battery_logger config.
```

## external/package/aa-proxy-rs/Config.in
```kconfig
config BR2_PACKAGE_AA_PROXY_RS
	bool "aa-proxy-rs"
	depends on BR2_PACKAGE_HOST_RUSTC_TARGET_ARCH_SUPPORTS
	select BR2_PACKAGE_HOST_RUSTC
	select BR2_PACKAGE_OPENSSL
	help
	  AndroidAuto wired/wireless proxy

if BR2_PACKAGE_AA_PROXY_RS

config BR2_PACKAGE_AA_PROXY_RS_IO_URING
	bool "io_uring support"
	default y
	help
	  Build aa-proxy-rs with its io-uring feature (tokio-uring).

	  This needs io_uring in the kernel, which arrived in 5.1. On an
	  older kernel tokio_uring::start() panics at startup with ENOSYS
	  and the proxy never runs, so turn this off for such boards.

endif
```

## external/package/cvi-mpi/Config.in
```kconfig
config BR2_PACKAGE_CVI_MPI
	bool "cvi-mpi (SG2000/SG2002 libsys, libvenc, libvdec)"
	depends on BR2_riscv
	select BR2_PACKAGE_CVI_OSDRV
	help
	  Userspace libraries of the Sophgo/Cvitek MPI used to access the
	  hardware H.264/H.265/JPEG encoder and decoder of the CV181x
	  family (SG2000/SG2002, Milk-V Duo S):

	    libsys   - ION/VB/system helpers (/dev/cvi-base, /dev/cvi-sys, /dev/ion)
	    libvenc  - CVI_VENC_* (talks to /dev/cvi_vc_enc%d)
	    libvdec  - CVI_VDEC_* (talks to /dev/cvi_vc_dec%d)

	  Headers are installed to staging in usr/include/cvi_mpi.
	  Kernel modules come from cvi-osdrv.

	  https://github.com/sophgo/cvi_mpi
```

## external/package/cvi-osdrv/Config.in
```kconfig
config BR2_PACKAGE_CVI_OSDRV
	bool "cvi-osdrv (SG2000/SG2002 hardware video codec kernel modules)"
	depends on BR2_LINUX_KERNEL
	help
	  Out-of-tree Sophgo/Cvitek kernel modules needed to use the
	  hardware H.264/H.265/JPEG encoder and decoder of the
	  CV181x family (SG2000/SG2002, Milk-V Duo S):

	    cv181x_sys, cv181x_base, cv181x_vcodec, cv181x_jpeg
	    and cvi_vc_driver (/dev/cvi_vc_enc%d, /dev/cvi_vc_dec%d)

	  Built from https://github.com/sophgo/osdrv against the kernel
	  built by Buildroot. Needs CONFIG_ION and CMA in the kernel
	  (already enabled in the milkv-duos board kernel config).

comment "cvi-osdrv needs a Linux kernel to be built"
	depends on !BR2_LINUX_KERNEL
```

## external/package/rkwifibt/Config.in
```kconfig
config BR2_PACKAGE_RKWIFIBT
	bool "Rockchip Bluetooth and Wi-Fi support"

config BR2_PACKAGE_RKWIFIBT_RTL8733BS
	bool "Realtek RTL8733BS support"
	depends on BR2_PACKAGE_RKWIFIBT

config BR2_PACKAGE_RKWIFIBT_AIC8800
	bool "AIC8800 support"
	depends on BR2_PACKAGE_RKWIFIBT

config BR2_PACKAGE_RKWIFIBT_AP625X
	bool "AP6254 / AP6255 / AP6256 (AW-CM256) support"
	depends on BR2_PACKAGE_RKWIFIBT
	help
	  Install the firmware for all three BCM43455/BCM43456 modules. Which
	  one a board is populated with is not fixed, and the device tree's
	  wifi_chip_type does not decide it: bcmdhd picks the Wi-Fi firmware
	  from the SDIO chip id it probes, and the Bluetooth init script picks
	  the matching patchram the same way.

config BR2_PACKAGE_RKWIFIBT_BT_UART_DEV
	string "Bluetooth UART dev"
	depends on BR2_PACKAGE_RKWIFIBT
	default "ttyS0"

config BR2_PACKAGE_RKWIFIBT_BT_UART_BAUDRATE
	string "Bluetooth UART baudrate"
	depends on BR2_PACKAGE_RKWIFIBT
	default "115200"
```

## external/package/uwe5622/Config.in
```kconfig
config BR2_PACKAGE_UWE5622
	bool "uwe5622 (AW859A / Unisoc UWE5622) WiFi driver"
	depends on BR2_LINUX_KERNEL
	help
	  Out-of-tree kernel module for the Unisoc/Spreadtrum UWE5622
	  wireless chip, packaged as "AW859A" on Allwinner boards
	  (e.g. Orange Pi Zero2W).

	  https://github.com/armbian/uwe5622

if BR2_PACKAGE_UWE5622

config BR2_PACKAGE_UWE5622_WIFI_PS
	bool "Enable WiFi power save"
	default n
	help
	  Corresponds to the driver's CONFIG_UNISOC_WIFI_PS option.

config BR2_PACKAGE_UWE5622_BLUETOOTH
	bool "Enable Bluetooth (tty-sdio)"
	default n
	help
	  Also build the Bluetooth-over-SDIO (tty-sdio) side of the driver.
	  It registers a tty exposing an H4-like HCI protocol; attach it
	  with btattach (e.g. from bluez5-utils) to bring up a hci interface.

endif
```
