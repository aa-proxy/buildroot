## external/Config.in
```kconfig
source "$BR2_EXTERNAL_AA_PROXY_OS_PATH/package/Config.in"
source "$BR2_EXTERNAL_AA_PROXY_OS_PATH/boot/Config.in"
```

## external/boot/Config.in
```kconfig
menu "Bootloaders"
    source "$BR2_EXTERNAL_AA_PROXY_OS_PATH/boot/uboot/Config.in"
endmenu
```

## external/configs/milkv-duos_defconfig
```kconfig
BR2_riscv=y
BR2_TOOLCHAIN_EXTERNAL=y
BR2_TOOLCHAIN_EXTERNAL_CUSTOM=y
BR2_TOOLCHAIN_EXTERNAL_PATH="$(TOPDIR)/../host-tools/gcc/riscv64-linux-musl-x86_64"
BR2_TOOLCHAIN_EXTERNAL_CUSTOM_PREFIX="riscv64-unknown-linux-musl"
BR2_TOOLCHAIN_EXTERNAL_GCC_10=y
BR2_TOOLCHAIN_EXTERNAL_HEADERS_5_10=y
BR2_TOOLCHAIN_EXTERNAL_CUSTOM_MUSL=y
BR2_TOOLCHAIN_EXTERNAL_CXX=y
BR2_TOOLCHAIN_EXTERNAL_OPENMP=y

BR2_PACKAGE_BUSYBOX_CONFIG_FRAGMENT_FILES="$(BR2_EXTERNAL_AA_PROXY_OS_PATH)/board/radxa03w/busybox.fragment"
BR2_ROOTFS_OVERLAY="$(BR2_EXTERNAL_AA_PROXY_OS_PATH)/rootfs_overlay"
BR2_GLOBAL_PATCH_DIR="$(BR2_EXTERNAL_AA_PROXY_OS_PATH)/board/milkv-duos/patches"
BR2_ROOTFS_PRE_BUILD_SCRIPT="$(BR2_EXTERNAL_AA_PROXY_OS_PATH)/board/milkv-duos/pre-build.sh"
BR2_ROOTFS_POST_BUILD_SCRIPT="$(BR2_EXTERNAL_AA_PROXY_OS_PATH)/board/milkv-duos/post-build.sh"
BR2_ROOTFS_POST_IMAGE_SCRIPT="$(BR2_EXTERNAL_AA_PROXY_OS_PATH)/board/milkv-duos/post-image.sh"

# Kernel config
BR2_LINUX_KERNEL=y
BR2_LINUX_KERNEL_CUSTOM_GIT=y
BR2_LINUX_KERNEL_CUSTOM_REPO_URL="https://github.com/sophgo/linux_5.10.git"
BR2_LINUX_KERNEL_CUSTOM_REPO_VERSION="88685c05097808fb6bf559c70a44a4d69f6e7034"
BR2_LINUX_KERNEL_USE_DEFCONFIG=n
BR2_LINUX_KERNEL_USE_CUSTOM_CONFIG=y
BR2_LINUX_KERNEL_CUSTOM_CONFIG_FILE="$(BR2_EXTERNAL_AA_PROXY_OS_PATH)/board/milkv-duos/kernel.config"

# Build the DTB from the kernel sources
BR2_PACKAGE_HOST_DTC=y
BR2_LINUX_KERNEL_DTS_SUPPORT=y
BR2_LINUX_KERNEL_CUSTOM_DTS_DIR="$(BR2_EXTERNAL_AA_PROXY_OS_PATH)/board/milkv-duos/dts"
BR2_LINUX_KERNEL_INTREE_DTS_NAME="cvitek/sg2000_milkv_duos_musl_riscv64_sd"

# Sophgo's U-Boot
BR2_TARGET_UBOOT=y
BR2_TARGET_UBOOT_BUILD_SYSTEM_KCONFIG=y
BR2_TARGET_UBOOT_CUSTOM_GIT=y
BR2_TARGET_UBOOT_CUSTOM_REPO_URL="https://github.com/sophgo/u-boot-2021.10"
BR2_TARGET_UBOOT_CUSTOM_REPO_VERSION="71a772fb2b32bb3a4ed0fe762266023e0aa21c1e"
BR2_TARGET_UBOOT_USE_CUSTOM_CONFIG=y
BR2_TARGET_UBOOT_CUSTOM_CONFIG_FILE="$(BR2_EXTERNAL_AA_PROXY_OS_PATH)/board/milkv-duos/u-boot/cvitek_sg2000_milkv_duos_musl_riscv64_sd_defconfig"
BR2_TARGET_UBOOT_NEEDS_OPENSBI=y
BR2_TARGET_UBOOT_NEEDS_DTC=y
BR2_TARGET_UBOOT_CUSTOM_DTS_PATH="$(BR2_EXTERNAL_AA_PROXY_OS_PATH)/board/milkv-duos/dts/cvitek/*dts*"
BR2_TARGET_UBOOT_CUSTOM_MAKEOPTS="CHIP=sg2000 CVIBOARD=milkv_duos_musl_riscv64_sd CONFIG_USE_DEFAULT_ENV=y CONFIG_SKIP_RAMDISK=y STORAGE_TYPE=sd"
BR2_TARGET_UBOOT_FORMAT_DTB=y

# OpenSBI
BR2_TARGET_OPENSBI=y
BR2_TARGET_OPENSBI_PLAT="generic"
BR2_TARGET_OPENSBI_CUSTOM_GIT=y
BR2_TARGET_OPENSBI_CUSTOM_REPO_URL="https://github.com/sophgo/opensbi"
BR2_TARGET_OPENSBI_CUSTOM_REPO_VERSION="6766e9cc96df51cde91540f9a15f291bf843b682"
BR2_TARGET_OPENSBI_UBOOT_PAYLOAD=y
BR2_TARGET_OPENSBI_FW_FDT_PATH=y
BR2_TARGET_OPENSBI_ADDITIONAL_VARIABLES="CHIP_ARCH=CV181X PM_SRAM_BIN_PATH=/app/buildroot/output/milkv-duos/build/opensbi-6766e9cc96df51cde91540f9a15f291bf843b682/pm_default_cv181x.bin"

BR2_TARGET_LDFLAGS="-march=rv64imafdcv0p7xthead -mcpu=c906fdv -mabi=lp64d -mcmodel=medany"
BR2_OPTIMIZE_S=y
BR2_TARGET_GENERIC_HOSTNAME="milkv-duo"
BR2_TARGET_GENERIC_ISSUE="Welcome to Milk-V DuoS RISCV64 SD"
BR2_TARGET_GENERIC_ROOT_PASSWD="milkv"
BR2_TARGET_ROOTFS_EXT2=y
BR2_TARGET_ROOTFS_EXT2_4=y
BR2_TARGET_ROOTFS_EXT2_SIZE="786432K"
BR2_PACKAGE_HOST_GENIMAGE=y
BR2_PACKAGE_HOST_DOSFSTOOLS=y
BR2_PACKAGE_HOST_MTOOLS=y

BR2_RISCV_ISA_RVC=y
BR2_PACKAGE_FREERTOS=y
```

## external/configs/qemu_defconfig
```kconfig
BR2_x86_64=y

BR2_SYSTEM_DHCP="eth0"

# Linux headers same as kernel
BR2_PACKAGE_HOST_LINUX_HEADERS_CUSTOM_6_12=y
BR2_GLOBAL_PATCH_DIR="board/qemu/patches $(BR2_EXTERNAL_AA_PROXY_OS_PATH)/patches"

# Kernel config
BR2_LINUX_KERNEL=y
BR2_LINUX_KERNEL_CUSTOM_VERSION=y
BR2_LINUX_KERNEL_CUSTOM_VERSION_VALUE="6.12.27"
BR2_LINUX_KERNEL_USE_CUSTOM_CONFIG=y
BR2_LINUX_KERNEL_CUSTOM_CONFIG_FILE="board/qemu/x86_64/linux.config"
BR2_LINUX_KERNEL_CONFIG_FRAGMENT_FILES="$(BR2_EXTERNAL_AA_PROXY_OS_PATH)/board/qemu/kernel.config $(BR2_EXTERNAL_AA_PROXY_OS_PATH)/board/common/kernel.config"
BR2_LINUX_KERNEL_NEEDS_HOST_LIBELF=y

# Rootfs overlay
BR2_ROOTFS_OVERLAY="$(BR2_EXTERNAL_AA_PROXY_OS_PATH)/board/common/rootfs_overlay $(BR2_EXTERNAL_AA_PROXY_OS_PATH)/board/rpi/rootfs_overlay"

# Enable compressed kernel module support
BR2_PACKAGE_BUSYBOX_SHOW_OTHERS=y
BR2_PACKAGE_KMOD=y
BR2_PACKAGE_KMOD_TOOLS=y
BR2_PACKAGE_XZ=y
BR2_PACKAGE_HOST_KMOD_XZ=y

# Required tools to create the SD image
BR2_PACKAGE_HOST_DOSFSTOOLS=y
BR2_PACKAGE_HOST_GENIMAGE=y
BR2_PACKAGE_HOST_GENEXT2FS=y
BR2_PACKAGE_HOST_MTOOLS=y

# Packages to bundle
BR2_PACKAGE_NANO=y
BR2_PACKAGE_RNG_TOOLS=y
BR2_PACKAGE_HAVEGED=y
BR2_PACKAGE_BLUEZ_TOOLS=y
BR2_PACKAGE_BLUEZ5_UTILS=y
BR2_PACKAGE_BLUEZ5_UTILS_CLIENT=y
BR2_PACKAGE_BLUEZ5_UTILS_TOOLS=y
BR2_PACKAGE_DNSMASQ=y
BR2_PACKAGE_DROPBEAR=y
BR2_PACKAGE_HOSTAPD=y
BR2_PACKAGE_WIRELESS_REGDB=y
BR2_PACKAGE_IW=y
BR2_PACKAGE_WPA_SUPPLICANT=y
BR2_PACKAGE_UTIL_LINUX=y
BR2_PACKAGE_UTIL_LINUX_RFKILL=y
BR2_PACKAGE_UMTPRD=y
BR2_PACKAGE_AA_PROXY_RS=y

# Other options
BR2_TARGET_GENERIC_ROOT_PASSWD="password"
# BR2_TARGET_GENERIC_GETTY is not set

# Filesystem / image
BR2_TARGET_GENERIC_REMOUNT_ROOTFS_RW=n
BR2_TARGET_ROOTFS_EXT2=y
BR2_TARGET_ROOTFS_EXT2_4=y
BR2_TARGET_ROOTFS_EXT2_SIZE="80M"
# BR2_TARGET_ROOTFS_TAR is not set
BR2_ROOTFS_POST_BUILD_SCRIPT="$(BR2_EXTERNAL_AA_PROXY_OS_PATH)/board/qemu/post-build.sh"
BR2_ROOTFS_POST_IMAGE_SCRIPT="$(BR2_EXTERNAL_AA_PROXY_OS_PATH)/board/qemu/post-image.sh"
BR2_ROOTFS_POST_SCRIPT_ARGS="$(BR2_DEFCONFIG)"
```

## external/configs/radxa03w_defconfig
```kconfig
BR2_aarch64=y
BR2_cortex_a55=y
BR2_ARM_FPU_NEON_VFPV4=y
BR2_ARM_EABIHF=y
BR2_TOOLCHAIN_BUILDROOT_CXX=y

# Kernel config
BR2_LINUX_KERNEL=y
BR2_LINUX_KERNEL_USE_DEFCONFIG=n
BR2_LINUX_KERNEL_USE_CUSTOM_CONFIG=y
BR2_LINUX_KERNEL_CUSTOM_CONFIG_FILE="$(BR2_EXTERNAL_AA_PROXY_OS_PATH)/board/radxa03w/kernel.config"
BR2_LINUX_KERNEL_CONFIG_FRAGMENT_FILES="$(BR2_EXTERNAL_AA_PROXY_OS_PATH)/board/common/kernel.config"
BR2_LINUX_KERNEL_LZ4=y
BR2_LINUX_KERNEL_NEEDS_HOST_OPENSSL=y
BR2_PACKAGE_HOST_LINUX_HEADERS_CUSTOM_6_12=y
BR2_LINUX_KERNEL_CUSTOM_VERSION_VALUE="6.12.35"
BR2_LINUX_KERNEL_CUSTOM_TARBALL=y
BR2_LINUX_KERNEL_CUSTOM_TARBALL_LOCATION="https://cdn.kernel.org/pub/linux/kernel/v6.x/linux-6.12.35.tar.xz"
BR2_LINUX_KERNEL_CUSTOM_DTS_DIR="$(BR2_EXTERNAL_AA_PROXY_OS_PATH)/board/radxa03w/dts"

# Build the DTB from the kernel sources
BR2_LINUX_KERNEL_DTS_SUPPORT=y
BR2_LINUX_KERNEL_INTREE_DTS_NAME="rockchip/rk3566-radxa-zero-3w"

# RockChip
BR2_PACKAGE_ROCKCHIP_RKBIN=y
BR2_PACKAGE_ROCKCHIP_RKBIN_TPL_FILENAME="bin/rk35/rk3566_ddr_528MHz_ultra_v1.10.bin"

# TF-A
BR2_TARGET_ARM_TRUSTED_FIRMWARE=y
BR2_TARGET_ARM_TRUSTED_FIRMWARE_LATEST_VERSION=y
BR2_TARGET_ARM_TRUSTED_FIRMWARE_PLATFORM="rk3568" # https://github.com/ARM-software/arm-trusted-firmware/blob/036935a8144b9c4b9f95f249ff4384945b846d40/docs/plat/rockchip.rst  RK3566=RK3568
BR2_TARGET_ARM_TRUSTED_FIRMWARE_BL31=y
BR2_TARGET_ARM_TRUSTED_FIRMWARE_IMAGES="bl31/*.elf"

# u-boot
BR2_TARGET_UBOOT=y
BR2_TARGET_UBOOT_NEEDS_ATF_BL31=y
BR2_TARGET_UBOOT_NEEDS_ATF_BL31_ELF=y
BR2_TARGET_UBOOT_NEEDS_GNUTLS=y
BR2_TARGET_UBOOT_NEEDS_OPENSSL=y
BR2_TARGET_UBOOT_NEEDS_PYTHON3=y
BR2_TARGET_UBOOT_NEEDS_PYELFTOOLS=y
BR2_TARGET_UBOOT_NEEDS_PYLIBFDT=y
BR2_TARGET_UBOOT_NEEDS_ROCKCHIP_RKBIN=y
BR2_TARGET_UBOOT_BUILD_SYSTEM_KCONFIG=y
BR2_PACKAGE_HOST_DTC=y
BR2_TARGET_UBOOT_USE_DEFCONFIG=y
BR2_TARGET_UBOOT_BOARD_DEFCONFIG="radxa-zero-3-rk3566"
BR2_TARGET_UBOOT_CONFIG_FRAGMENT_FILES="$(BR2_EXTERNAL_AA_PROXY_OS_PATH)/board/radxa03w/uboot.fragment"
BR2_PACKAGE_HOST_UBOOT_TOOLS=y
BR2_PACKAGE_HOST_UBOOT_TOOLS_BOOT_SCRIPT=y
BR2_PACKAGE_HOST_UBOOT_TOOLS_BOOT_SCRIPT_SOURCE="$(BR2_EXTERNAL_AA_PROXY_OS_PATH)/board/radxa03w/boot.cmd"

# Wireless Drivers
BR2_PACKAGE_AIC8800=y
BR2_PACKAGE_AIC8800_INTERFACE_SDIO=y
BR2_PACKAGE_AIC8800_WLAN=y
BR2_PACKAGE_AIC8800_BT_WORKAROUND=y
BR2_PACKAGE_AIC8800_FW_AIC8800D80=y

# Rootfs overlay
BR2_ROOTFS_OVERLAY="$(BR2_EXTERNAL_AA_PROXY_OS_PATH)/rootfs_overlay $(BR2_EXTERNAL_AA_PROXY_OS_PATH)/board/radxa03w/rootfs_overlay"
BR2_GLOBAL_PATCH_DIR="$(BR2_EXTERNAL_AA_PROXY_OS_PATH)/patches $(BR2_EXTERNAL_AA_PROXY_OS_PATH)/board/radxa03w/patches"
BR2_DOWNLOAD_FORCE_CHECK_HASHES=y

# Enable compressed kernel module support
BR2_PACKAGE_BUSYBOX_SHOW_OTHERS=y
BR2_PACKAGE_KMOD=y
BR2_PACKAGE_KMOD_TOOLS=y
BR2_PACKAGE_XZ=y
BR2_PACKAGE_HOST_KMOD_XZ=y

# BusyBox
BR2_PACKAGE_BUSYBOX_CONFIG_FRAGMENT_FILES="$(BR2_EXTERNAL_AA_PROXY_OS_PATH)/board/radxa03w/busybox.fragment"

# Required tools to create the SD image
BR2_PACKAGE_HOST_DOSFSTOOLS=y
BR2_PACKAGE_HOST_GENIMAGE=y
BR2_PACKAGE_HOST_MTOOLS=y

# Other options
BR2_TARGET_GENERIC_ROOT_PASSWD="password"
# BR2_TARGET_GENERIC_GETTY is not set

# Filesystem / image
BR2_TARGET_GENERIC_REMOUNT_ROOTFS_RW=n
BR2_TARGET_ROOTFS_EXT2=y
BR2_TARGET_ROOTFS_EXT2_4=y
BR2_TARGET_ROOTFS_EXT2_SIZE="100M"
# BR2_TARGET_ROOTFS_TAR is not set
BR2_ROOTFS_POST_BUILD_SCRIPT="$(BR2_EXTERNAL_AA_PROXY_OS_PATH)/board/radxa03w/post-build.sh"
BR2_ROOTFS_POST_IMAGE_SCRIPT="$(BR2_EXTERNAL_AA_PROXY_OS_PATH)/board/radxa03w/post-image.sh"
```

## external/configs/rpi02w_defconfig
```kconfig
BR2_aarch64=y
BR2_cortex_a53=y
BR2_ARM_FPU_VFPV4=y
BR2_TOOLCHAIN_EXTERNAL_BOOTLIN_AARCH64_GLIBC_STABLE=y
BR2_LINUX_KERNEL_DEFCONFIG="bcm2711"
BR2_LINUX_KERNEL_INTREE_DTS_NAME="broadcom/bcm2710-rpi-zero-2-w"
BR2_ROOTFS_OVERLAY="$(BR2_EXTERNAL_AA_PROXY_OS_PATH)/rootfs_overlay $(BR2_EXTERNAL_AA_PROXY_OS_PATH)/board/rpi/rootfs_overlay"
BR2_PACKAGE_RPI_FIRMWARE_BOOTCODE_BIN=y
BR2_PACKAGE_RPI_FIRMWARE_VARIANT_PI=y
BR2_PACKAGE_RPI_FIRMWARE_VARIANT_PI_CD=y
```

## external/configs/rpi0w_defconfig
```kconfig
BR2_arm=y
BR2_arm1176jzf_s=y
BR2_ARM_EABIHF=y
BR2_TOOLCHAIN_EXTERNAL_BOOTLIN_AARCH64_GLIBC_STABLE=n
BR2_TOOLCHAIN_EXTERNAL_BOOTLIN_ARMV6_EABIHF_GLIBC_STABLE=y
BR2_LINUX_KERNEL_DEFCONFIG="bcmrpi"
BR2_LINUX_KERNEL_INTREE_DTS_NAME="broadcom/bcm2708-rpi-zero-w"
BR2_ROOTFS_OVERLAY="$(BR2_EXTERNAL_AA_PROXY_OS_PATH)/rootfs_overlay $(BR2_EXTERNAL_AA_PROXY_OS_PATH)/board/rpi/rootfs_overlay"
BR2_PACKAGE_RPI_FIRMWARE_BOOTCODE_BIN=y
BR2_PACKAGE_RPI_FIRMWARE_VARIANT_PI=y
BR2_PACKAGE_RPI_FIRMWARE_VARIANT_PI_CD=y
```

## external/configs/rpi5_defconfig
```kconfig
BR2_aarch64=y
BR2_cortex_a76=y
BR2_TOOLCHAIN_EXTERNAL_BOOTLIN_AARCH64_GLIBC_STABLE=y
BR2_LINUX_KERNEL_DEFCONFIG="bcm2712"
BR2_LINUX_KERNEL_INTREE_DTS_NAME="broadcom/bcm2712-rpi-5-b"
BR2_ROOTFS_OVERLAY="$(BR2_EXTERNAL_AA_PROXY_OS_PATH)/rootfs_overlay $(BR2_EXTERNAL_AA_PROXY_OS_PATH)/board/rpi/rootfs_overlay $(BR2_EXTERNAL_AA_PROXY_OS_PATH)/board/rpi4/rootfs_overlay"
BR2_SYSTEM_DHCP="eth0"
```

## external/package/Config.in
```kconfig
menu "Packages"
    source "$BR2_EXTERNAL_AA_PROXY_OS_PATH/package/aa-proxy-rs/Config.in"
    source "$BR2_EXTERNAL_AA_PROXY_OS_PATH/package/aa-proxy-wican/Config.in"
    source "$BR2_EXTERNAL_AA_PROXY_OS_PATH/package/aa-proxy-go-obd-feeder/Config.in"
    source "$BR2_EXTERNAL_AA_PROXY_OS_PATH/package/rkwifibt/Config.in"
    source "$BR2_EXTERNAL_AA_PROXY_OS_PATH/package/aic8800/Config.in"
endmenu
```

## external/package/aa-proxy-go-obd-feeder/Config.in
```kconfig
config BR2_PACKAGE_AA_PROXY_GO_OBD_FEEDER
	bool "aa-proxy-go-obd-feeder"
	depends on BR2_PACKAGE_HOST_GO_TARGET_ARCH_SUPPORTS
	help
	  A little golang companion app for aa-proxy-rs that scrapes USB OBD Scanners for state of charge information and injects it into aa-proxy-rs
```

## external/package/aa-proxy-wican/Config.in
```kconfig
config BR2_PACKAGE_AA_PROXY_WICAN
	bool "aa-proxy-wican"
	depends on BR2_PACKAGE_HOST_RUSTC_TARGET_ARCH_SUPPORTS
	select BR2_PACKAGE_HOST_RUSTC
	help
	  AndroidAuto wired/wireless proxy WiCAN client
```

## external/package/aic8800/Config.in
```kconfig
menuconfig BR2_PACKAGE_AIC8800
    bool "AIC8800 Support"
    help
      AICSemi AIC8800 Wireless Drivers

if BR2_PACKAGE_AIC8800

choice
    prompt "AIC8800 Chip Interface"
    default BR2_PACKAGE_AIC8800_INTERFACE_SDIO

    config BR2_PACKAGE_AIC8800_INTERFACE_SDIO
        select BR2_PACKAGE_AIC8800_BSP
        bool "SDIO"

    config BR2_PACKAGE_AIC8800_INTERFACE_USB
        bool "USB"

    config BR2_PACKAGE_AIC8800_INTERFACE_PCIE
        bool "PCIe"
endchoice

config BR2_PACKAGE_AIC8800_BSP
    bool
    default n

config BR2_PACKAGE_AIC8800_WLAN
    bool "AIC8800 WLAN Support"
    default y

config BR2_PACKAGE_AIC8800_BT_SDIO_FORCED
    bool
    default y if BR2_PACKAGE_AIC8800_INTERFACE_SDIO && (BR2_PACKAGE_AIC8800_FW_AIC8800D80 || BR2_PACKAGE_AIC8800_FW_AIC8800D80X2)

choice
    default BR2_PACKAGE_AIC8800_BT_NONE if !BR2_PACKAGE_AIC8800_BT_SDIO_FORCED
    default BR2_PACKAGE_AIC8800_BT_SDIO if BR2_PACKAGE_AIC8800_BT_SDIO_FORCED
    prompt "AIC8800 Bluetooth Driver"

config BR2_PACKAGE_AIC8800_BT_LPM
    bool "AICSemi SDIO/UART Bluetooth Driver"
    depends on BR2_PACKAGE_AIC8800_INTERFACE_SDIO
    help
        We are unsure about the functionality of this driver.

config BR2_PACKAGE_AIC8800_BT_SDIO
    bool "AICSemi SDIO Bluetooth Driver"
    depends on BR2_PACKAGE_AIC8800_BT_SDIO_FORCED
    help
        Allows bluetooth to be used over SDIO instead of UART

config BR2_PACKAGE_AIC8800_BT_USB
    bool "AICSemi USB Bluetooth driver"
    depends on BR2_PACKAGE_AIC8800_INTERFACE_USB

config BR2_PACKAGE_AIC8800_BT_NONE
    bool "No Bluetooth support"
    depends on !BR2_PACKAGE_AIC8800_BT_SDIO_FORCED

endchoice

menu "Firmware Images"
config BR2_PACKAGE_AIC8800_FW_AIC8800
    depends on !BR2_PACKAGE_AIC8800_INTERFACE_PCIE
    bool "AIC8800 Firmware Images"

config BR2_PACKAGE_AIC8800_FW_AIC8800D80
    depends on !(BR2_PACKAGE_AIC8800_INTERFACE_PCIE && BR2_PACKAGE_AIC8800_FW_AIC8800D80X2)
    bool "AIC8800D80 Firmware Images" 

config BR2_PACKAGE_AIC8800_FW_AIC8800D80N
    depends on !BR2_PACKAGE_AIC8800_INTERFACE_PCIE
    bool "AIC8800D80N Firmware Images" 

config BR2_PACKAGE_AIC8800_FW_AIC8800D80X2
    bool "AIC8800D80X2 Firmware Images"

config BR2_PACKAGE_AIC8800_FW_AIC8800DC
    depends on !BR2_PACKAGE_AIC8800_INTERFACE_PCIE
    bool "AIC8800DC Firmware Images"
endmenu

endif
```
